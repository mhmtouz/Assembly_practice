    LIST P=16F877A
    #INCLUDE <P16F877A.INC>
    __CONFIG H'3F31'
    SAYAC EQU 0X20
    SAYAC_BIRLER EQU 0X21
    SAYAC_ONLAR EQU 0X22
    BEKLE EQU 0X23
    BEKLE2 EQU 0X24
    ORG 0X00
    GOTO MAIN
    ORG 0X04
KESME
    BANKSEL PIR1
    BCF PIR1,TMR1IF
    BANKSEL TMR1H
    MOVLW H'3C'
    MOVWF TMR1H
    MOVLW H'B0'
    MOVWF TMR1L
    DECFSZ SAYAC,F
    RETFIE
    MOVLW D'10'
    MOVWF SAYAC 
    INCF SAYAC_BIRLER
    RETFIE
MAIN
    BANKSEL TRISB
    CLRF TRISB 
    BANKSEL TRISA
    CLRF TRISA 
    MOVLW 0X06
    MOVWF ADCON1
    BANKSEL PORTB
    CLRF PORTB
    CLRF PORTA
    MOVLW D'10'
    MOVWF SAYAC
    CLRF SAYAC_BIRLER
    CLRF SAYAC_ONLAR
    BANKSEL TMR1H
    MOVLW H'3C'
    MOVWF TMR1H
    MOVLW H'B0'
    MOVWF TMR1L
    BANKSEL INTCON
    MOVLW B'11000000'
    MOVWF INTCON
    BANKSEL PIE1
    BSF PIE1,TMR1IE
    BANKSEL T1CON
    BCF T1CON,T1CKPS1
    BSF T1CON,T1CKPS0
    BSF T1CON,TMR1ON
KONTROL
    BCF PORTA,1    
    BSF PORTA,0
    MOVFW SAYAC_ONLAR
    SUBLW D'6'
    BTFSC STATUS,Z
    CLRF SAYAC_ONLAR
    CALL YAZDIR    
    MOVWF SAYAC_BIRLER
    SUBLW D'10'
    BTFSS STATUS,Z
    GOTO KONTROL
    CLRF SAYAC_BIRLER
    INCF SAYAC_ONLAR
    GOTO KONTROL
YAZDIR    
    BCF PORTA,1    
    BSF PORTA,0
    MOVFW SAYAC_ONLAR
    CALL LOOKUP_RAKAMLAR
    MOVWF PORTB
    CALL BEKLEME
    BSF PORTA,1    
    BCF PORTA,0
    MOVFW SAYAC_BIRLER
    CALL LOOKUP_RAKAMLAR
    MOVWF PORTB
    CALL BEKLEME
    RETURN
LOOKUP_RAKAMLAR
    ADDWF PCL,F   
    RETLW B'00111111' ;0
    RETLW B'00000110' ;1                            
    RETLW B'01011011' ;2    
    RETLW B'01001111' ;3
    RETLW B'01100110' ;4
    RETLW B'01101101' ;5
    RETLW B'01111101' ;6
    RETLW B'00000111' ;7
    RETLW B'01111111' ;8    
    RETLW B'01101111' ;9
    RETURN
BEKLEME
    MOVLW D'45'
    MOVWF BEKLE
BEKLEME2
    MOVLW D'255'
    MOVWF BEKLE2  
BEKLEMEDONGU
    DECFSZ BEKLE2,F
    GOTO BEKLEMEDONGU
    DECFSZ BEKLE,F
    GOTO BEKLEME2
    RETURN 
    END