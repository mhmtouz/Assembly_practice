	LIST P=16F877A
	#INCLUDE <P16F877A.INC>
	SAYAC EQU 0X20
	ORG 0X00
	GOTO ANAPROG
	ORG 0X04
	GOTO KESME
ANAPROG
	BANKSEL TRISB
	CLRF TRISB
	BANKSEL PORTB
	CLRF PORTB
	MOVLW D'15'
	MOVWF SAYAC
	BANKSEL OPTION_REG
	MOVLW B'01000111' ; GIE PEIE T0CS TOSE PSA PS2 PS1 PS0
	MOVWF OPTION_REG
	BANKSEL INTCON
	BSF INTCON,GIE ; TÜM KESMELERÝ AKTÝF EDER
	BSF INTCON,PEIE ; HARÝCÝ KESMELERE ÝZÝN VERÝR
	BSF INTCON,TMR0IE; TÝMER0 AÇAR
	BCF INTCON,TMR0IF; TIMER0'IN BAYRAGINI SIFIRLAR
DONGU
	GOTO DONGU
KESME
	BANKSEL INTCON
	BCF INTCON,TMR0IF ; KESMEYE GÝRÝNCE TAÞMA OLUÞUR(FLAG 1), ONU TEKRAR SIFIRLIYORUZ
	DECFSZ SAYAC,F ; SAYACI KONTROL ET, KONTROL BÝTÝNCE ÝSLEMÝ YAP(KESME SÜRESÝ*SAYAC=65MS*15=1SN)
	RETFIE
	GOTO ISLEM 
ISLEM
	BANKSEL PORTB
	INCF PORTB
	MOVLW D'15'
	MOVWF SAYAC
	RETFIE
	END
