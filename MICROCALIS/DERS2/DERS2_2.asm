	LIST P=16F877A
	#INCLUDE <P16F877A.INC>
	SAYAC EQU 0X20
	ORG 0X00
	GOTO MAIN
	ORG 0X04
	GOTO KESME
MAIN
	BANKSEL TRISB
	CLRF TRISB
	BANKSEL PORTB
	CLRF PORTB
	MOVLW D'10'
	MOVWF SAYAC ;63C0
	BANKSEL TMR1H
	MOVLW H'63'
	MOVWF TMR1H
	MOVLW H'C0'
	MOVWF TMR1L
	BANKSEL INTCON
	MOVLW B'11000000'
 	BANKSEL PIE1
	BSF PIE1,TMR1IE
	BANKSEL T1CON
	BSF T1CON,T1CKPS1
	BCF T1CON,T1CKPS0
	BSF T1CON,TMR1ON
DONGU
	GOTO DONGU
KESME
	BANKSEL PIR1
	BCF PIR1,TMR1IF
	BANKSEL TMR1H
	MOVLW H'63'
	MOVWF TMR1H
	MOVLW H'C0'
	MOVWF TMR1L
	DECFSZ SAYAC,F
	RETFIE
	GOTO ISLEM
ISLEM
	BANKSEL PORTB
	INCF PORTB
	MOVLW D'10'
	MOVWF SAYAC
 	RETFIE


END
	