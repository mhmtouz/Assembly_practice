    LIST P=16F877A
    #INCLUDE <P16F877A.INC>
    __CONFIG H'3F31'
    BEKLE EQU 0X20
    BEKLE2 EQU 0X21
    ORG 0X00
    GOTO MAIN
    ORG 0X04
KESME
    BANKSEL PIR1
    BCF PIR1,ADIF
    CALL GOSTER
    BANKSEL ADCON0
    BSF ADCON0,GO
    RETFIE
MAIN
    BANKSEL TRISA
    BSF TRISA,1
    CLRF TRISB  
    BANKSEL PORTB
    CLRF PORTB
    BANKSEL PORTA
    CLRF PORTA
    BANKSEL ADCON1
    CLRF ADCON1 ;HEPS? ANALOG G?R?? VE SOLA DAYALI     KULLANILAN(ADRESH 01234567) LAZIN DE??L(ADRESL 89------)
    BANKSEL INTCON
    BSF INTCON,GIE
    BSF INTCON,PEIE    
    BANKSEL PIE1
    BSF PIE1,ADIE
    BANKSEL ADCON0
    MOVLW D'11001101';ADCS1 ADCS0 CHS2 CHS2 CHS0 GO/DONE - ADON
    MOVWF ADCON0
DONGU
    GOTO DONGU
GOSTER
    BANKSEL ADRESH
    MOVFW ADRESH
    BANKSEL PORTB
    MOVWF PORTB
    CALL BEKLEME
    RETURN
BEKLEME
    MOVLW D'255'
    MOVWF BEKLE
BEKLEME2
    MOVLW D'255'
    MOVWF BEKLE2  
BEKLEMEDONGU
    DECFSZ BEKLE2,F
    GOTO BEKLEMEDONGU
    DECFSZ BEKLE,F
    GOTO BEKLEME2
    RETURN
    
    END