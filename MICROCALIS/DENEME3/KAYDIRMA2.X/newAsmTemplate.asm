 LIST P=16F877A
    #INCLUDE <P16F877A.INC>
    SAYI EQU 0X21
    SAYAC EQU 0X22
    ORG 0X00
    GOTO MAIN
MAIN
    BANKSEL TRISB
    CLRF TRISB
    BSF PORTD,1
    BSF PORTC,1
    BANKSEL PORTD
    CLRF PORTB
    CLRF PORTC
    CLRF PORTD
    MOVLW B'00000001'
    MOVWF PORTB
    MOVLW D'255'
    MOVWF SAYAC
    GOTO BUTON1
    GOTO SON
BUTON1
    BTFSS PORTC,0
    GOTO BUTON2
    GOTO YAK1
BUTON2
    BTFSS PORTD,0
    GOTO BUTON1
    GOTO YAK2
YAK1
    RLF PORTB
    GOTO BEKLEME
YAK2
    RRF PORTB
    GOTO BEKLEME
BEKLEME
    DECFSZ SAYAC
    GOTO BEKLEME
    GOTO BUTON1
    
SON 
    END 


