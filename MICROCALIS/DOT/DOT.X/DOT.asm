    LIST P=16F877A
    #INCLUDE <P16F877A.INC>
    __CONFIG H'3F31'
    S1 EQU 0X20
    BEKLE EQU 0X21
    BEKLE2 EQU 0X22
    ORG 0X00
MAIN
    BANKSEL TRISB
    CLRF TRISB
    CLRF TRISC
    BANKSEL PORTC
    CLRF PORTC
    CLRF PORTB
    CLRF S1
ISLEM
   MOVFW S1
   SUBLW D'5'
   BTFSC STATUS,Z
   CLRF S1
   CALL YAK
   GOTO ISLEM
YAK
   MOVFW S1
   CALL LOOKCC
   MOVWF PORTC
   CALL BEKLEME
   MOVFW S1
   CALL LOOKBB
   MOVWF PORTB
   CALL BEKLEME   
   INCF S1
   RETURN
LOOKBB
    ADDWF PCL,F
    RETLW B'01111100'
    RETLW B'01111100'
    RETLW B'01111100'
    RETLW B'01111100'
    RETLW B'00000000'

LOOKCC
    ADDWF PCL,F
    RETLW B'00000001'
    RETLW B'00000010'
    RETLW B'00000100'
    RETLW B'00001000'
    RETLW B'00010000'
 
BEKLEME
    MOVLW D'1'
    MOVWF BEKLE
BEKLEME2
    MOVLW D'1'
    MOVWF BEKLE2 
BEKLEMEDONGU
    DECFSZ BEKLE2,F
    GOTO BEKLEMEDONGU
    DECFSZ BEKLE,F
    GOTO BEKLEME2
    RETURN  
    END
    
    
    
    