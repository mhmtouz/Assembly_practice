    LIST P=16F877A
    #INCLUDE <P16F877A.INC>
    __CONFIG H'3F31'
    TEMP EQU 0X20
    TEMP2 EQU 0X25
    SAYI EQU 0X21
    SAYAC EQU 0X22
    BEKLE EQU 0X23
    BEKLE2 EQU 0X24 
    VE EQU 0X25
    VE2 EQU 0X26
    KAY1 EQU 0X28
    AAA EQU 0X29
    BBB EQU 0X27
 
 
    ORG 0X00
MAIN
    BANKSEL TRISB
    CLRF TRISB
    BSF TRISA,0
    BSF TRISA,1
    BANKSEL ADCON1
    MOVLW 0X06
    MOVWF ADCON1
    BANKSEL PORTB
    CLRF PORTB
    MOVLW 0X35
    MOVWF SAYI    
    MOVLW 0X04
    MOVWF SAYAC
    MOVLW 0X18
    MOVWF KAY1
    MOVLW 0X80
    MOVWF AAA
    MOVLW 0X81
    MOVWF BBB
    CALL TEMIZLE
    GOTO WRITE
TEMIZLE    
    MOVLW 0X01
    CALL KOMUT_YAZ
    MOVLW 0X02
    CALL KOMUT_YAZ
    MOVLW 0X0C
    CALL KOMUT_YAZ
    MOVLW 0X28
    CALL KOMUT_YAZ
    RETURN
KOMUT_YAZ    
    MOVWF TEMP
    MOVWF TEMP2    
    CALL DEGISTIR
    MOVFW TEMP2
    CALL KOMUT_GONDER
    MOVFW TEMP
    CALL KOMUT_GONDER
    RETURN
SAYIAL            
    MOVLW 0X04
    MOVWF SAYAC
    RETURN
DEGISTIR
    RRF TEMP2
    DECFSZ SAYAC,F
    GOTO DEGISTIR
    MOVLW 0X04
    MOVWF SAYAC
    RETURN
KOMUT_GONDER
    MOVWF VE
    CALL VER1
    MOVFW VE
    MOVWF PORTB
    BANKSEL PORTB
    BCF PORTB,4
    BSF PORTB,5
    CALL BEKLEME
    BCF PORTB,5
    RETURN
VER1
    RLF VE
    DECFSZ SAYAC,F
    GOTO VER1
    CALL VER2
    MOVLW 0X04
    MOVWF SAYAC
    RETURN
VER2
    RRF VE
    DECFSZ SAYAC,F
    GOTO VER2
    RETURN
SAG
    MOVLW 0X8F
    SUBWF AAA,W
    BTFSS STATUS,Z
    GOTO ARTTIR
    GOTO BOS
ARTTIR
    INCF AAA
    INCF BBB
    GOTO WRITE
BOS
    MOVLW 0X80
    MOVWF AAA
    MOVLW 0X81
    MOVWF BBB
    GOTO WRITE
WRITE
    CALL TEMIZLE
    
    MOVFW AAA
    CALL KOMUT_YAZ
    MOVLW A'2'
    CALL VERI_YAZ
    
    MOVFW BBB
    CALL KOMUT_YAZ
    MOVLW A'3'
    CALL VERI_YAZ
    GOTO SAG
DONGU
    GOTO DONGU
VERI_YAZ
    MOVWF TEMP
    SWAPF TEMP,W
    CALL VERI_GONDER
    MOVFW TEMP
    CALL VERI_GONDER
    RETURN
VERI_GONDER
    ANDLW 0X0F
    MOVWF PORTB
    BANKSEL PORTB
    BSF PORTB,4
    BSF PORTB,5
    CALL BEKLEME
    BCF PORTB,5
    RETURN
BEKLEME
    MOVLW D'30'
    MOVWF BEKLE
BEKLEME2
    MOVLW D'80'
    MOVWF BEKLE2
BEKLEMEDONGU
    DECFSZ BEKLE2,F
    GOTO BEKLEMEDONGU
    DECFSZ BEKLE,F
    GOTO BEKLEME2
    RETURN
    END
    
    
    
    
    
    
    
    
    
    
    
    
    
