
    LIST P=16F877A
    #INCLUDE <P16F877A.INC>
    __CONFIG H'3F31'
    BEKLE EQU 0X20
    BEKLE2 EQU 0X21
    TEMP EQU 0X22
    ORG 0X00
    GOTO MAIN
    ORG	0X04
KESME
    BANKSEL PIR1
    BCF PIR1,RCIF
    BANKSEL RCREG
    MOVFW RCREG
    CALL VERIGONDER
    RETFIE
TEMIZLE
    MOVLW 0X02
    CALL CMDYAZ
    MOVLW 0X38
    CALL CMDYAZ
    MOVLW 0X0C
    CALL CMDYAZ
    MOVLW 0X80
    CALL CMDYAZ
    RETURN
MAIN
    BANKSEL TRISB
    CLRF TRISB
    CLRF TRISD
    BSF TRISC,7
    BANKSEL PORTD
    CLRF PORTB
    CLRF PORTD
    
    CALL TEMIZLE
    
    BANKSEL SPBRG
    MOVLW B'00011001'
    MOVWF SPBRG
    BANKSEL TXSTA
    MOVLW B'00000100'
    MOVWF TXSTA
    BANKSEL RCSTA
    MOVLW B'10010000'
    MOVWF RCSTA
    
    BANKSEL INTCON
    BSF INTCON,GIE
    BSF INTCON,PEIE
    BANKSEL PIE1    
    BSF PIE1,RCIE
DONGU
    GOTO DONGU
VERIGONDER
    BANKSEL PORTD
    MOVWF PORTD   
    BANKSEL PORTB
    BSF PORTB,4
    BSF PORTB,6
    CALL BEKLEME
    BCF PORTB,6
    RETURN
CMDYAZ
    BANKSEL PORTD
    MOVWF PORTD    
    BANKSEL PORTB
    BCF PORTB,4
    BSF PORTB,6
    CALL BEKLEME
    BCF PORTB,6
    RETURN
BEKLEME
    MOVLW 0X30
    MOVWF BEKLE
BEKLEME2
    MOVLW 0X80
    MOVWF BEKLE2
BEKLEMEDONGU
    DECFSZ BEKLE2,F
    GOTO BEKLEMEDONGU
    DECFSZ BEKLE,F
    GOTO BEKLEME2
    RETURN    
    END

    
    
    
    
    
    
    
    
    
    
    