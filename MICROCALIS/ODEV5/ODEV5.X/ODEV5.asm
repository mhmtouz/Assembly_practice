    LIST P=16F877A
    #INCLUDE <P16F877A.INC>
    __CONFIG H'3F31'
    ARTIS EQU 0X20
    ORG 0X00
MAIN
    BANKSEL PORTA
    CLRF PORTC
    CLRF PORTA   
    MOVLW D'1'
    MOVWF ARTIS
    BANKSEL ADCON1
    MOVLW D'6'
    MOVWF ADCON1   
    BANKSEL TRISC
    CLRF TRISC
    MOVLW B'00001111'
    MOVWF TRISA
    BANKSEL T2CON
    BSF T2CON,TMR2ON ;2.BIT
    BCF T2CON,T2CKPS1 ; PRESCALER 00 1:1
    BSF T2CON,T2CKPS0
    BANKSEL PR2
    MOVLW D'49'
    MOVWF PR2
    BANKSEL CCP1CON
    MOVLW B'00001100' ;HESAPLA
    MOVWF CCP1CON
    MOVLW B'00000101';HESAPLA
    MOVWF CCPR1L
    BANKSEL CCP2CON
    MOVLW B'00001100' ;HESAPLA
    MOVWF CCP2CON
    MOVLW B'00001111';HESAPLA
    MOVWF CCPR2L  
ANAKONTROL
    BTFSC PORTA,0
    GOTO KONTROLMOTORART
    BTFSC PORTA,1
    GOTO KONTROLMOTORART
    BTFSC PORTA,2
    GOTO KONTROLLEDART
    BTFSC PORTA,3
    GOTO KONTROLLEDART
    GOTO ANAKONTROL
KONTROLMOTORART
    BTFSS PORTA,0
    GOTO KONTROLMOTORAZ
    GOTO ARTTIRMOTOR
KONTROLMOTORAZ    
    BTFSS PORTA,1
    GOTO KONTROLMOTORART
    GOTO AZALTMOTOR
ARTTIRMOTOR
    BTFSC PORTA,0
    GOTO ARTTIRMOTOR
    MOVFW ARTIS
    ADDWF CCPR1L,F
    GOTO ANAKONTROL
AZALTMOTOR
    BTFSC PORTA,1
    GOTO AZALTMOTOR
    MOVFW ARTIS
    SUBWF CCPR1L,F
    GOTO ANAKONTROL
KONTROLLEDART
    BTFSS PORTA,2
    GOTO KONTROLLEDAZ
    GOTO ARTTIRLED
KONTROLLEDAZ    
    BTFSS PORTA,3
    GOTO KONTROLLEDART
    GOTO AZALTLED
ARTTIRLED
    BTFSC PORTA,2
    GOTO ARTTIRLED
    MOVFW ARTIS
    ADDWF CCPR2L,F
    GOTO ANAKONTROL
AZALTLED
    BTFSC PORTA,3
    GOTO AZALTLED
    MOVFW ARTIS
    SUBWF CCPR2L,F
    GOTO ANAKONTROL
    END
    
    
    
    


