    LIST P=16F877A
    #INCLUDE <P16F877A.INC>
    __CONFIG H'3F31'
    SAYAC EQU 0X20 
    SSS EQU 0X21
    ORG 0X00
    GOTO MAIN
    ORG 0X04
    GOTO KESME
MAIN
    BANKSEL PORTB
    CLRF PORTB
    MOVLW D'30'
    MOVWF SAYAC
    BANKSEL TRISB
    CLRF TRISB 
    BANKSEL OPTION_REG
    MOVLW B'00000111'
    MOVWF OPTION_REG
    BANKSEL INTCON
    BSF INTCON,GIE
    BSF INTCON,PEIE
    BSF INTCON,TMR0IE
    BCF INTCON,TMR0IF
    BANKSEL TMR0
    MOVLW D'60'
    MOVWF TMR0
    CLRW
DONGU
    GOTO DONGU
KESME
    BCF INTCON,TMR0IF
    MOVLW D'60'
    MOVWF TMR0
    DECFSZ SAYAC,F
    RETFIE
    CALL ISLEM
    RETFIE
ISLEM
    COMF PORTB
    MOVLW D'30'
    MOVWF SAYAC
    RETURN
    END

