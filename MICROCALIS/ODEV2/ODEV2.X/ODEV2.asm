    LIST P=16F877A
    #INCLUDE <P16F877A.INC>
    __CONFIG H'3F31'
    SAYAC EQU 0X20
    SAYACYEDEK EQU 0X21
    ALTSINIR EQU 0X22
    USTSINIR EQU 0X23
    ORG 0X00
    GOTO MAIN
    ORG 0X04
    GOTO KESME
MAIN
    BANKSEL TRISB
    CLRF TRISB 
    MOVLW 0X06
    MOVWF ADCON1
    BANKSEL PORTB
    CLRF PORTB
    MOVLW D'10'
    MOVWF SAYAC
    MOVWF SAYACYEDEK
    MOVLW D'5'
    MOVWF ALTSINIR
    MOVLW D'15'
    MOVWF USTSINIR
    BANKSEL TMR1H
    MOVLW H'3C'
    MOVWF TMR1H
    MOVLW H'B0'
    MOVWF TMR1L
    BANKSEL INTCON
    MOVLW B'11000000'
    MOVWF INTCON
    BANKSEL PIE1
    BSF PIE1,TMR1IE
    BANKSEL T1CON
    BCF T1CON,T1CKPS1
    BSF T1CON,T1CKPS0
    BSF T1CON,TMR1ON
    GOTO BUTONHIZLAN
KESME
    BANKSEL PIR1
    BCF PIR1,TMR1IF
    BANKSEL TMR1H
    MOVLW H'3C'
    MOVWF TMR1H
    MOVLW H'B0'
    MOVWF TMR1L
    DECFSZ SAYAC,F
    RETFIE
    GOTO SAY
SAY
    BANKSEL PORTB
    INCF PORTB
    MOVFW SAYACYEDEK
    MOVWF SAYAC
    RETFIE
BUTONHIZLAN
    BTFSS PORTA,0
    GOTO BUTONYAVASLA
    GOTO HIZLAN
BUTONYAVASLA
    BTFSS PORTA,1
    GOTO BUTONHIZLAN
    GOTO YAVASLA 
HIZLAN
    MOVFW SAYACYEDEK
    SUBWF ALTSINIR,W
    BTFSC PORTA,0
    GOTO HIZLAN
    BTFSS STATUS,Z
    DECF SAYACYEDEK
    NOP
    CALL BUTONYAVASLA
    GOTO BUTONHIZLAN    
YAVASLA  
    MOVFW SAYACYEDEK
    SUBWF USTSINIR,W
    BTFSC PORTA,1
    GOTO YAVASLA
    BTFSS STATUS,Z
    INCF SAYACYEDEK
    NOP
    CALL BUTONHIZLAN
    GOTO BUTONYAVASLA
    END
    



