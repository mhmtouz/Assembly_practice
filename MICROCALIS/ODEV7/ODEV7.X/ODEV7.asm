    LIST P=16F877A
    #INCLUDE <P16F877A.INC>
    __CONFIG H'3F31'
    BEKLE EQU 0X22
    BEKLE2 EQU 0X23
    ORG 0X00
    GOTO MAIN
    ORG 0X04
KESME
    BANKSEL PIR1
    BCF PIR1,RCIF
    BANKSEL RCREG
    MOVFW RCREG	
    CALL DATASEND
    RETFIE
MAIN
    BANKSEL TRISB
    CLRF TRISB
    CLRF TRISD
    BSF TRISC,7
    BANKSEL PORTB
    CLRF PORTB
    CLRF PORTD
    
    CALL LCDREADY
    
    BSF PORTB,2
    BCF PORTB,3
    BANKSEL SPBRG
    MOVLW B'00011001'	
    MOVWF SPBRG
    BANKSEL TXSTA
    MOVLW B'00000100'	
    MOVWF TXSTA
    BANKSEL RCSTA
    MOVLW B'10010000'
    MOVWF RCSTA
    BANKSEL INTCON
    BSF INTCON,GIE
    BSF INTCON,PEIE
    BANKSEL PIE1
    BSF PIE1,RCIE
DONGU 
    GOTO DONGU
LCDREADY
    MOVLW 0X02
    CALL CMDSEND
    MOVLW 0X38	
    CALL CMDSEND
    MOVLW 0X0C
    CALL CMDSEND
    MOVLW 0X80
    CALL CMDSEND
    RETURN
CMDSEND
    BANKSEL PORTD
    MOVWF PORTD
    BANKSEL PORTB
    BCF PORTB,5
    BCF PORTB,4
    BSF PORTB,6
    CALL BEKLEME
    BCF PORTB,6
    RETURN
DATASEND
    BANKSEL PORTD
    MOVWF PORTD
    BANKSEL PORTB
    BCF PORTB,5
    BSF PORTB,4
    BSF PORTB,6
    CALL BEKLEME
    BCF PORTB,6
    RETURN 
BEKLEME
    MOVLW 0X30
    MOVWF BEKLE
BEKLEME2
    MOVLW 0X80
    MOVWF BEKLE2
BEKLEMEDONGU
    DECFSZ BEKLE2,F
    GOTO BEKLEMEDONGU
    DECFSZ BEKLE,F
    GOTO BEKLEME2
    RETURN    
    END
