
		LIST P=16F877A
	#INCLUDE "P16F877A.INC"
	DEGER EQU 0X20
	DEGER2 EQU 0X21
	SAYAC EQU 0X22
	SAYAC2 EQU 0X23
	ORG 0X00
MAIN
	BANKSEL TRISB
	CLRF TRISB
	CLRF TRISC

	BANKSEL PORTB
	CLRF PORTB
	MOVLW B'00000001'
	MOVWF PORTC

	MOVLW 0X00
	MOVWF SAYAC

	MOVLW 0X05
	MOVWF SAYAC2

ISLEM
	RLF PORTC,F
	MOVF SAYAC,W
	CALL LOOKUP
	MOVWF PORTB
	
	CALL GECIKME
	INCF SAYAC,F
	DECFSZ SAYAC2,F
	GOTO ISLEM
	
	MOVLW 0X00
	MOVWF SAYAC

	MOVLW 0X05
	MOVWF SAYAC2

	MOVLW B'00000001'
	MOVWF PORTC

	GOTO ISLEM

LOOKUP
	ADDWF PCL,F
	RETLW B'00010001'
	RETLW B'00001010'
	RETLW B'00000100'
	RETLW B'00000100'
	RETLW B'00000100'
	RETURN


GECIKME
	MOVLW 0X02
	MOVWF DEGER
DONGU
	MOVLW 0XFF
	MOVWF DEGER2
DONGU2
	DECFSZ DEGER2,F
	GOTO DONGU2
	DECFSZ DEGER,F
	GOTO DONGU
	RETURN
END	
	 