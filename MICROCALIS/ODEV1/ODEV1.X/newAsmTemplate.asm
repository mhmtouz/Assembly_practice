    LIST P=16F877A
    #INCLUDE <P16F877A.INC>
    __CONFIG H'3F31'
    SAYI1 EQU 0X24
    SAYI2 EQU 0X25
    SONUCL EQU 0X26
    SONUCH EQU 0X27
    BEKLE EQU 0X29
    BEKLE2 EQU 0X30
    ORG 0X00
    GOTO MAIN
MAIN
    BANKSEL ADCON1
    MOVLW D'6'
    MOVWF ADCON1
    BANKSEL TRISB
    CLRF TRISB
    CLRF TRISA
    BSF TRISA,0
    BANKSEL PORTB
    CLRF PORTB
    CLRF PORTA
    CLRF SAYI1
    CLRF SAYI2
    CLRF SONUCH
    CLRF SONUCL
    CLRF BEKLE
    CLRF BEKLE2
    MOVLW D'100'
    MOVWF SAYI1
    MOVLW D'3'
    MOVWF SAYI2 
    CLRW
ISLEM
    ADDWF SAYI1,W
    MOVWF SONUCL
    BTFSS STATUS,C
    GOTO SONL
    GOTO SONH
SONL
    DECFSZ SAYI2,F
    GOTO ISLEM
    GOTO BUTON
SONH
    BCF STATUS,C
    INCF SONUCH
    DECFSZ SAYI2,F
    GOTO ISLEM
    GOTO BUTON
BUTON
    CALL BEKLEME
    BTFSS PORTA,0
    GOTO BUTON
    GOTO L
L
    MOVFW SONUCL
    MOVWF PORTB
    CALL BEKLEME
    BTFSS PORTA,0
    GOTO L
    GOTO H
H    
    MOVFW SONUCH
    MOVWF PORTB
    CALL BEKLEME
    BTFSS PORTA,0
    GOTO H
    GOTO L

BEKLEME
    MOVLW D'255'
    MOVWF BEKLE
BEKLEME2
    MOVLW D'255'
    MOVWF BEKLE2  
BEKLEMEDONGU
    DECFSZ BEKLE2,F
    GOTO BEKLEMEDONGU
    DECFSZ BEKLE,F
    GOTO BEKLEME2
    RETURN  
    END
    






