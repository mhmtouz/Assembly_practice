    LIST P=16F877A
    #INCLUDE <P16F877A.INC>
    __CONFIG H'3F31'
    TEMP EQU 0X24
    SB1 EQU 0X25
    SB2 EQU 0X26
    ORG 0X00
MAIN
    BANKSEL TRISB
    CLRF TRISB
    CLRF TRISD
    BANKSEL PORTB
    CLRF PORTB
    CLRF PORTD
    CALL TEMIZLE
    BSF PORTB,2
    BCF PORTB,3
    CALL KARAKTER
TEMIZLE
    MOVLW 0X02
    CALL KOMUTYAZ
    MOVLW 0X0C
    CALL KOMUTYAZ
    MOVLW 0X28
    CALL KOMUTYAZ
    RETURN
KARAKTER
    MOVLW 0X80
    CALL KOMUTYAZ
    MOVLW A'M'
    CALL VERIYAZ
    
    MOVLW 0X81
    CALL KOMUTYAZ
    MOVLW A'E'
    CALL VERIYAZ
        
    MOVLW 0X82
    CALL KOMUTYAZ
    MOVLW A'H'
    CALL VERIYAZ 
    
    MOVLW 0X83
    CALL KOMUTYAZ    
    MOVLW A'M'
    CALL VERIYAZ 
    
    MOVLW 0X84
    CALL KOMUTYAZ
    MOVLW A'E'   
    CALL VERIYAZ
        
    MOVLW 0X85
    CALL KOMUTYAZ
    MOVLW A'T'   
    CALL VERIYAZ
    
    MOVLW 0XC0
    CALL KOMUTYAZ
    MOVLW A'U'
    CALL VERIYAZ    
    MOVLW A'G'
    CALL VERIYAZ
    MOVLW A'U'
    CALL VERIYAZ
    MOVLW A'Z'
    CALL VERIYAZ
    GOTO SON
KOMUTYAZ
    MOVWF TEMP
    SWAPF TEMP,W
    CALL KOMUTGONDER
    MOVFW TEMP
    CALL KOMUTGONDER
    RETURN
KOMUTGONDER
    ANDLW 0X0F
    BANKSEL PORTB
    MOVWF PORTD
    BCF PORTB,4
    BSF PORTB,6
    CALL BEKLE
    BCF PORTB,6
    RETURN
VERIYAZ
    MOVWF TEMP
    SWAPF TEMP,W
    CALL VERIGONDER
    MOVFW TEMP
    CALL VERIGONDER
    RETURN
VERIGONDER
    ANDLW 0X0F
    BANKSEL PORTB
    MOVWF PORTD
    BSF PORTB,4
    BSF PORTB,6
    CALL BEKLE	
    BCF PORTB,6
    RETURN
BEKLE
    MOVLW 0X10
    MOVWF SB1
BEKLE2
    MOVLW 0X10
    MOVWF SB2
BEKLED
    DECFSZ BEKLE2
    GOTO BEKLED
    DECFSZ BEKLE
    GOTO BEKLE2
    RETURN
SON
    END