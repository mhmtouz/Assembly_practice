	LIST P=16F877A
	INCLUDE <P16F877A.INC>
	__CONFIG _CP_OFF &_WDT_OFF &_HS_OSC &_PWRTE_OFF &_LVP_OFF

SAYAC0	EQU	0x20
SAYAC1 	EQU	0x21
SAYAC2 	EQU	0x22
BIRLER 	EQU	0x23
ONLAR	EQU	0x24
YUZLER 	EQU	0x25
BINLER	EQU	0x26
ISTENEN	EQU	0x27
ESIK	EQU	0x28
TEMP	EQU	0x29
TEMP1	EQU 0x2A
TEMP2 	EQU	0x2B


;*****************RESET VECTOR***********
	ORG 0x00
	GOTO BASLA

;*****************INTERRUPT VECTOR*******
	ORG	0x04
	
	RETFIE                    	; Kesme 'den don

;*****************MACRO TANIMLANABÝLÝR***
BANK0 MACRO
	  BCF STATUS,5
	  ENDM
BANK1 MACRO
	  BSF STATUS,5
	  ENDM

BEKLE ; YAKLASIK 3MS GECIKME
	MOVLW .2
	MOVWF SAYAC0
AZALT1
	MOVLW .50
	MOVWF SAYAC1
AZALT2
	MOVLW .50
	MOVWF SAYAC2
AZALT3
	DECFSZ SAYAC2,F
	GOTO AZALT3
	DECFSZ SAYAC1,F
	GOTO AZALT2
	DECFSZ SAYAC0,F
	GOTO AZALT1

	RETURN

BEKLE2 ; YAKLASIK 300MS GECIKME
	MOVLW .50
	MOVWF SAYAC0
AZALTT1
	MOVLW .100
	MOVWF SAYAC1
AZALTT2
	MOVLW .100
	MOVWF SAYAC2 
AZALTT3
	DECFSZ SAYAC2,F
	GOTO AZALTT3
	DECFSZ SAYAC1,F
	GOTO AZALTT2
	DECFSZ SAYAC0,F
	GOTO AZALTT1

	RETURN

BEKLE3 ; YAKLASIK 1.5MS GECIKME
	MOVF  TEMP1,W
	MOVWF SAYAC0
AZALTTT1
	MOVLW .50
	MOVWF SAYAC1
AZALTTT2
	MOVLW .50
	MOVWF SAYAC2
AZALTTT3
	DECFSZ SAYAC2,F
	GOTO AZALTTT3
	DECFSZ SAYAC1,F
	GOTO AZALTTT2
	DECFSZ SAYAC0,F
	GOTO AZALTTT1

	RETURN


GOSTER
	MOVF YUZLER,W
	MOVWF PORTD
	MOVLW B'00000010'
	MOVWF  PORTB
	CALL  BEKLE2
	MOVF  ONLAR,W
	MOVWF PORTD        ; 7448 ENTEGRESÝNE 4 TANE LED BAÐLANABÝLÝYOR.PORTDNÝN 4 PÝNÝ ÝLE VERÝYÝ, PORTBNÝN 4 PÝNÝ ÝLE HANGÝ DISPLAYÝN ÇALIÞACAÐINI SEÇÝYORUZ.VERÝYÝ DÝREK DECÝMAL OLARAK GÖNDEREBÝLÝYORUZ.
	MOVLW B'00000100'
	MOVWF  PORTB
	CALL  BEKLE2
	MOVF  BIRLER,W
	MOVWF PORTD
	MOVLW B'00001000'
	MOVWF PORTB
	CALL  BEKLE2
	CLRF  PORTB 
	RETURN

BASAMAKBUL        ; ÜÇ BASMAKLI SAYILAR ÝÇÝN BASAMAK DEÐERLERÝNÝ BULAN ALTPROGRAM
	CLRF BIRLER
	CLRF ONLAR
	CLRF YUZLER
	MOVF TEMP1,W
	MOVWF TEMP
BASAMAKDEVAM1
	BCF STATUS,C
	BCF STATUS,Z
	MOVLW .100
	SUBWF TEMP,W   ; ISTENEN SICAKLIKTAN ODA SICAKLIÐI ÇIKARILDI.
	BTFSC STATUS,Z
	GOTO ESITLIK1
	BTFSC STATUS,C   ; ÇIKARILAN DEÐER DAHA BÜYÜKSE C BÝTÝ 0 OLUR AKSÝ HALDE 1 OLUR.
	GOTO BUYUKLUK1
	GOTO BASAMAKDEVAM2
ESITLIK1
	INCF YUZLER,F
	RETURN
BUYUKLUK1
	INCF YUZLER,F
	MOVWF TEMP
	GOTO BASAMAKDEVAM1

BASAMAKDEVAM2
	BCF STATUS,C
	BCF STATUS,Z
	MOVLW .10
	SUBWF TEMP,W   ; ISTENEN SICAKLIKTAN ODA SICAKLIÐI ÇIKARILDI.
	BTFSC STATUS,Z
	GOTO ESITLIK2
	BTFSC STATUS,C   ; ÇIKARILAN DEÐER DAHA BÜYÜKSE C BÝTÝ 0 OLUR AKSÝ HALDE 1 OLUR.
	GOTO BUYUKLUK2
	MOVF TEMP,W
	MOVWF BIRLER
	RETURN
ESITLIK2
	INCF ONLAR,F
	RETURN
BUYUKLUK2
	INCF ONLAR,F
	MOVWF TEMP
	GOTO BASAMAKDEVAM2




YONTESPIT            ; DC MOTOR ÝLERÝ/GERÝ/ORTA DURUMUNU ALGILAMAK
	BCF STATUS,C
	BCF STATUS,Z
	MOVF ESIK,W
	SUBWF ISTENEN,W   
	BTFSC STATUS,Z
	GOTO ESITLIK
	BTFSC STATUS,C   ; ÇIKARILAN DEÐER DAHA BÜYÜKSE C BÝTÝ 0 OLUR AKSÝ HALDE 1 OLUR.
	GOTO SOLADONDUR
	BSF PORTC,0  	 ; RCO = 1 OLDU SAÐA DÖNME AKTÝF
	MOVF ISTENEN,W
	SUBLW .127
	MOVWF TEMP1
	BCF STATUS,C
	RLF	 TEMP1,F
	INCF TEMP1,F
	RETURN

ESITLIK
	CLRF TEMP1
	RETURN

SOLADONDUR
	BCF PORTC,0      ; RCO = 0 OLDU SOLA DÖNME AKTÝF
	MOVLW .128
	SUBWF ISTENEN,W
	MOVWF TEMP1
	BCF STATUS,C
	RLF	 TEMP1,F
	INCF TEMP1,F
	RETURN




ADCOKU
	MOVLW B'00101001'
	MOVWF ADCON0
	BANK1
	CLRF ADCON1
	BANK0
	BSF ADCON0,2    ; GO PÝNÝ 1 YAPILDI BÖYLECE ADC ÝÞLEME BAÞLADI
ADCDEVAM
	BTFSC ADCON0,2  ; GO PÝNÝ 0 OLDU ÝSE ÝÞLEM BÝTMÝÞ DEMEKTÝR. 
 	GOTO ADCDEVAM
	MOVF ADRESH,W  ; DÖNÜÞTÜRME ÝÞLEMÝNÝN SONUCU ADRESH REGÝSTÝRINA YAZILDI. 
	MOVWF ISTENEN
	CLRF ADCON0
	BANK1
	MOVLW .6
	MOVWF ADCON1
	CLRF TRISA
	BANK0
	RETURN

SAGA
	MOVLW .10
	MOVWF TEMP2
SAGA1
	MOVLW B'00001010'    ; DEFTERDE YÖNLERÝN OLUÞMA TABLOSU VE MANTIÐI VAR.ORDAN YAPTIK.
	MOVWF PORTA
	CALL BEKLE3
	MOVLW B'00000110'
	MOVWF PORTA
	CALL BEKLE3          ; STEP MOTOR ÝÇÝN HER ADIMDA GEREKEN BEKLEMEYÝ SAÐLIYOR.
	MOVLW B'00000101'
	MOVWF PORTA
	CALL BEKLE3
	MOVLW B'00001001'
	MOVWF PORTA
	CALL BEKLE3
	CLRF PORTA
	DECFSZ TEMP2,F
	GOTO SAGA1
	RETURN

SOLA
	MOVLW .10
	MOVWF TEMP2
SOLA1
	MOVLW B'00001001'
	MOVWF PORTA
	CALL BEKLE3
	MOVLW B'00000101'
	MOVWF PORTA
	CALL BEKLE3
	MOVLW B'00000110'
	MOVWF PORTA
	CALL BEKLE3
	MOVLW B'00001010'
	MOVWF PORTA  
	CALL BEKLE3
	CLRF PORTA
	DECFSZ TEMP2,F
	GOTO SOLA1
	RETURN
	

KONTROL
	BCF STATUS,Z
	MOVF TEMP1,F
	BTFSC STATUS,Z
	RETURN
	BTFSC PORTC,0
	GOTO SOLKE
	CALL SAGA
	RETURN
SOLKE		
	CALL SOLA
	RETURN



;*****************BASLANGIC**************

BASLA

	BANK1       ; ADCON1 AYARLANACAK
	CLRF TRISB
	CLRF TRISD
	CLRF TRISC
	BANK0 
	CLRF PORTA
	CLRF PORTB
	CLRF PORTD
	BCF PORTC,0
	MOVLW .0
	MOVWF YUZLER
	MOVLW .0
	MOVWF ONLAR
	MOVLW .0
	MOVWF BIRLER
	MOVLW .128
	MOVWF ESIK         ; JOYSTIK ORTA NOKTASI ÝÇÝN EÞÝK DEÐER 

LOOP
	CALL ADCOKU        ; RE0/AN5 JOYSTIK ÝLERÝ/GERÝ HAREKETÝ DÝJÝTALLEÞTÝ
	CALL YONTESPIT	
	CALL BASAMAKBUL
	CALL GOSTER
	CALL KONTROL	
	GOTO LOOP

END	
