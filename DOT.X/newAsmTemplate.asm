    LIST P=16F877A
    #INCLUDE <P16F877A.INC>
    __CONFIG H'3F31'
    S1 EQU 0X24
    SB1 EQU 0X25
    SB2 EQU 0X26
    ORG 0X00
MAIN
    BANKSEL TRISB
    CLRF TRISB
    CLRF TRISC
    BANKSEL PORTB
    CLRF PORTB
    CLRF PORTD
    MOVLW 0X05
    MOVWF S1
ISLEM
    MOVFW S1
    DECFSZ S1,F
    GOTO YAK
    CALL YUKLE
    GOTO ISLEM
YAK
    MOVFW S1
    CALL LOOKUPCC
    MOVWF PORTC
    CALL BEKLE
    MOVFW S1
    CALL LOOKUPBB
    MOVWF PORTB
    CALL BEKLE
    GOTO ISLEM
YUKLE
    MOVLW 0X05
    MOVWF S1
    RETURN
LOOKUPBB
    ADDWF PCL,F
    RETLW B'01111100'
    RETLW B'01111100'
    RETLW B'01111100'
    RETLW B'01111100'
    RETLW B'01111100'
    RETURN
LOOKUPCC 
    ADDWF PCL,F
    RETLW B'00000001'
    RETLW B'00000010'
    RETLW B'00000100'
    RETLW B'00001000'
    RETLW B'00010000'
    RETURN
BEKLE
    MOVLW 0X01
    MOVWF SB1
BEKLE2
    MOVLW 0X01
    MOVWF SB2
BEKLED
    DECFSZ SB2,F
    GOTO BEKLED
    DECFSZ SB1,F
    GOTO BEKLE2
    RETURN
    END