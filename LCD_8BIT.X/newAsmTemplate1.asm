    LIST P=16F877A
    #INCLUDE<P16F877A.INC>
    __CONFIG H'3F31'
    TEMP EQU 0X23
    BEKLE EQU 0X24
    BEKLE2 EQU 0X25
    ORG 0X00
MAIN
    BANKSEL TRISB
    CLRF TRISB
    CLRF TRISD
    BANKSEL PORTD
    CLRF PORTD
    CLRF PORTB    
    CALL TEMIZLE
    BSF PORTB,2
    BCF PORTB,3
    GOTO ISLEM
TEMIZLE
    MOVLW 0X02
    CALL KOMUTGONDER
    MOVLW 0X0C
    CALL KOMUTGONDER
    MOVLW 0X28
    CALL KOMUTGONDER
    RETURN
ISLEM
    MOVLW 0X80    
    CALL KOMUTGONDER
    MOVLW A'O'
    CALL VERIGONDER
    MOVLW 0X81    
    CALL KOMUTGONDER
    MOVLW A'U'
    CALL VERIGONDER
    MOVLW 0X82    
    CALL KOMUTGONDER
    MOVLW A'Z'
    CALL VERIGONDER
    
    MOVLW 0XC0    
    CALL KOMUTGONDER
    MOVLW A'7'
    CALL VERIGONDER
    MOVLW 0XC1    
    CALL KOMUTGONDER
    MOVLW A'0'
    CALL VERIGONDER
    GOTO SON
KOMUTYAZ
    MOVWF TEMP
    SWAPF TEMP,W
    CALL KOMUTGONDER
    MOVFW TEMP
    CALL KOMUTGONDER
    RETURN
KOMUTGONDER
    BANKSEL PORTD
    MOVWF PORTD
    BCF PORTB,4
    BSF PORTB,6
    CALL BEKLEME
    BCF PORTB,6
    RETURN
VERIYAZ
    MOVWF TEMP
    SWAPF TEMP,W
    CALL VERIGONDER
    MOVFW TEMP
    CALL VERIGONDER
    RETURN
VERIGONDER
    BANKSEL PORTD
    MOVWF PORTD
    BSF PORTB,4
    BSF PORTB,6
    CALL BEKLEME
    BCF PORTB,6
    RETURN
BEKLEME
    MOVLW 0X07
    MOVWF BEKLE
BEKLEME2
    MOVLW 0X27
    MOVWF BEKLE2
BEKLEMED
    DECFSZ BEKLE2,F
    GOTO BEKLEMED
    DECFSZ BEKLE,F
    GOTO BEKLEME2
    RETURN
SON    
    END


