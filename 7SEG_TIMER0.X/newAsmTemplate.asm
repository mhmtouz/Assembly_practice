    LIST P=16F877A
    #INCLUDE <P16F877A.INC>
    __CONFIG H'3F31'
    SAYAC EQU 0X23
    SAY EQU 0X22
    BEKLE EQU 0X25
    BEKLE2 EQU 0X26
    ORG 0X00
    GOTO MAIN
    ORG 0X04 
    GOTO KESME
MAIN
    BANKSEL TRISB
    CLRF TRISB
    CLRF TRISD
    BANKSEL PORTD
    CLRF PORTD
    CLRF PORTB
    MOVLW 0XFF
    MOVWF SAYAC
    CLRF SAY
    BANKSEL OPTION_REG
    MOVLW D'00000111'
    MOVWF OPTION_REG
    BANKSEL INTCON
    BSF INTCON,GIE
    BSF INTCON,T0IE    
    BCF INTCON,T0IF
    BANKSEL TMR0
    MOVLW 0X06
    MOVWF TMR0
DONGU
    GOTO DONGU
KESME
    BANKSEL INTCON
    BCF INTCON,T0IF
    BANKSEL TMR0
    MOVLW 0X0E
    MOVWF TMR0
    DECFSZ SAYAC,F
    RETFIE
    CALL ISLEM
    BANKSEL SAYAC
    MOVLW 0XFF
    MOVWF SAYAC
    RETFIE
ISLEM
    MOVFW SAY
    SUBLW 0X0A
    BTFSS STATUS,Z
    GOTO YAK
    CLRF SAY
    GOTO YAK
    RETURN
YAK
    MOVFW SAY
    CALL LOOKUP
    MOVWF PORTD
    BSF PORTB,4
    BSF PORTB,6
    CALL BEKLEME
    BCF PORTB,6
    INCF SAY
    RETFIE    
LOOKUP
    ADDWF PCL,F
    RETLW B'00111111'   
    RETLW B'00000110'    
    RETLW B'01011011'    
    RETLW B'01001111'    
    RETLW B'01100110'    
    RETLW B'01101101'    
    RETLW B'01111101'    
    RETLW B'00000111'    
    RETLW B'01111111'    
    RETLW B'01101111'
    RETURN
BEKLEME
    MOVLW 0X55
    MOVWF BEKLE
BEKLEME2
    MOVLW 0X15
    MOVWF BEKLE2
BEKLEMED
    DECFSZ BEKLE2,F
    GOTO BEKLEMED
    DECFSZ BEKLE,F
    GOTO BEKLEME2
    RETURN
    END
    