    LIST P=16F877A
    #INCLUDE <P16F877A.INC>
    __CONFIG H'3F31'
    BEKLE EQU 0X20
    BEKLE2 EQU 0X21
    ORG 0X00
    GOTO MAIN
    ORG 0X04
KESME
    BANKSEL PIR1
    BCF PIR1,ADIF
    CALL GOSTER
    BANKSEL ADCON0
    BSF ADCON0,GO
    RETFIE
MAIN
    BANKSEL TRISA
    BSF TRISA,1
    CLRF TRISB  
    BANKSEL PORTB
    CLRF PORTB
    BANKSEL PORTA
    CLRF PORTA
    BANKSEL ADCON1
    CLRF ADCON1 ;KULLANILAN(ADRESH 01234567) LAZIN DE??L(ADRESL 89------)   bit7 ADFM=0(HEPS? ANALOG)SOLA DAYALI
    BANKSEL INTCON
    BSF INTCON,GIE
    BSF INTCON,PEIE    
    BANKSEL PIE1
    BSF PIE1,ADIE
    BANKSEL ADCON0
    MOVLW D'11001101';(ADCS1 ADCS0 -> Dahili osilatör kaynag?) (CHS2 CHS2 CHS0 -> Hangi PORTA giri?i oldu?u) (GO/DONE -> ADC i?lem yap?l?yor) (- -> bit1 kullan?lmaz) (ADON -> ADC aç?k)
    MOVWF ADCON0
DONGU
    GOTO DONGU
GOSTER
    BANKSEL ADRESH
    MOVFW ADRESH
    BANKSEL PORTB
    MOVWF PORTB
    CALL BEKLEME
    RETURN
BEKLEME
    MOVLW D'255'
    MOVWF BEKLE
BEKLEME2
    MOVLW D'255'
    MOVWF BEKLE2  
BEKLEMEDONGU
    DECFSZ BEKLE2,F
    GOTO BEKLEMEDONGU
    DECFSZ BEKLE,F
    GOTO BEKLEME2
    RETURN
    
    END


