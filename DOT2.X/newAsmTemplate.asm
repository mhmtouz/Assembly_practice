    LIST P=16F877A
    #INCLUDE<P16F877A.INC>
    __CONFIG H'3F31'
    SAYACDONGU EQU 0X21
    SAYACHB EQU 0X22
    SAYACHC EQU 0X23
    GEC1 EQU 0X24
    GEC2 EQU 0X25
    ORG 0X00
    GOTO MAIN

MAIN
    BANKSEL ADCON1
    MOVLW D'6'
    MOVWF ADCON1
    BANKSEL TRISB
    CLRF TRISB
    BANKSEL TRISC
    CLRF TRISC
    BANKSEL PORTA
    CLRF PORTA
    CLRF PORTB
    CLRF PORTC
    CLRF SAYACDONGU
    CLRF SAYACHC
    CLRF SAYACHB
    MOVLW D'6'
    MOVWF SAYACDONGU
    DONGU
    DECFSZ SAYACDONGU,F
    GOTO YAK
    GOTO YENILE
YAK
    CALL GECIKME
    MOVFW SAYACHC
    CALL LOOKHC
    MOVWF PORTC
    MOVFW SAYACHB
    CALL LOOKHB
    MOVWF PORTB
    CALL GECIKME
    INCF SAYACHC
    INCF SAYACHB
    GOTO DONGU

YENILE
    MOVLW D'6'
    MOVWF SAYACDONGU
    CLRF SAYACHC
    CLRF SAYACHB
    GOTO DONGU

LOOKHB
    ADDWF PCL,F
    RETLW B'00000000'
    RETLW B'00110110'
    RETLW B'00110110'
    RETLW B'00110110'
    RETLW B'01001001'
LOOKHC
    ADDWF PCL,F
    RETLW B'00000001'
    RETLW B'00000010'
    RETLW B'00000100'
    RETLW B'00001000'
    RETLW B'00010000' 

GECIKME
    MOVLW D'5'
    MOVWF GEC1
GECIKME0
    MOVLW D'2'
    MOVWF GEC2  

GECIKME1
    DECFSZ GEC2,F
    GOTO GECIKME1
    DECFSZ GEC1,F
    GOTO GECIKME0
    RETURN

    END