LIST P=16F877A
#INCLUDE <P16F877A.INC>
__CONFIG _CP_OFF &_WDT_OFF &_HS_OSC &_PWRTE_OFF

SAYI0 EQU 0X20
SAYI1 EQU 0X21
SAYI2 EQU 0X22
BIRLER EQU 0X23
ONLAR EQU 0X24
YUZLER EQU 0X25
BINLER EQU 0X26
TEMP1 EQU 0X27
TEMP2 EQU 0X28
TEMP3 EQU 0X29
TEMP4 EQU 0X30
TEMP0 EQU 0X31



ORG 0X00
GOTO PROGRAM
ORG 0X04
GOTO PROGRAM


PROGRAM
BANKSEL TRISC
CLRF TRISC
BANKSEL PORTC
MOVLW 0X01
MOVWF PORTC
BCF STATUS,C
GOTO SOLA


SAGA
BANKSEL PORTC
CALL BEKLE0
RRF PORTC,F
BTFSC PORTC,0
GOTO SOLA
GOTO SAGA


SOLA
BANKSEL PORTC
CALL BEKLE0
RLF PORTC,F
BTFSC PORTC,7
GOTO SAGA
GOTO SOLA



BEKLE0
BANKSEL SAYI0
MOVLW .50
MOVWF SAYI0
BEKLE1
MOVLW .50
MOVWF SAYI1
BEKLE2
MOVLW .50
MOVWF SAYI2
BEKLE3
DECFSZ SAYI2,F
GOTO BEKLE3
DECFSZ SAYI1,F
GOTO BEKLE2
DECFSZ SAYI0,F
GOTO BEKLE1
RETURN







END