LIST P=16F877A
#INCLUDE <P16F877A.INC>
__CONFIG H'3F31'

SAYI0 EQU 0X20
SAYI1 EQU 0X21
SAYI2 EQU 0X22
BIRLER EQU 0X23
ONLAR EQU 0X24
YUZLER EQU 0X25
BINLER EQU 0X26
TEMP1 EQU 0X27
TEMP2 EQU 0X28
TEMP3 EQU 0X29
TEMP4 EQU 0X30
TEMP0 EQU 0X31



ORG 0X00
GOTO PROGRAM
ORG 0X04
GOTO PROGRAM


PROGRAM
BANKSEL TRISB
CLRF TRISB
MOVLW B'11110000'
MOVWF TRISD
BANKSEL PORTB
CLRF PORTB
CLRF PORTD
MOVLW .0
MOVWF BIRLER
MOVWF ONLAR
MOVWF YUZLER
MOVWF BINLER
GOTO LOOP0




LOOP0
MOVLW .10
MOVWF TEMP1
LOOP1
MOVLW .10
MOVWF TEMP2
LOOP2
MOVLW .10
MOVWF TEMP3
LOOP3
MOVLW .10
MOVWF TEMP4
LOOP4
CALL GOSTER
INCF BIRLER,F
DECFSZ TEMP4,F
GOTO LOOP4
CLRF BIRLER
INCF ONLAR,F	
DECFSZ TEMP3,F
GOTO LOOP3
CLRF ONLAR
INCF YUZLER,F
DECFSZ TEMP2,F
GOTO LOOP2
CLRF YUZLER
INCF BINLER,F
DECFSZ TEMP1,F
GOTO LOOP1
CLRF BINLER
GOTO LOOP0


GOSTER
BANKSEL PORTB
MOVLW B'00001000'
MOVF BIRLER,W
MOVWF PORTD
MOVLW B'00000100'
MOVF ONLAR,W
MOVWF PORTD
MOVLW B'00000010'
MOVF YUZLER,W
MOVWF PORTD
MOVLW B'00000001'
MOVF BINLER,W
MOVWF PORTD
RETURN



BEKLE0
MOVLW .50
MOVWF SAYI0
BEKLE1
MOVLW .50
MOVWF SAYI1
BEKLE2
MOVLW .50
MOVWF SAYI2
BEKLE3
DECFSZ SAYI2,F
GOTO BEKLE2
DECFSZ SAYI1,F
GOTO BEKLE1
DECFSZ SAYI0,F
GOTO BEKLE0
RETURN







END