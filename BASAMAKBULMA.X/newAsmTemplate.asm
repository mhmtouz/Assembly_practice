    LIST P=16F877A
    #INCLUDE <P16F877A.INC>
    __CONFIG H'3F31'
    SAYI EQU 0X24    
    BIRLER EQU 0X25
    ONLAR EQU 0X26
    ON EQU 0X29
    TEMP EQU 0X27
    ORG 0X00
MAIN
    BANKSEL ADCON1
    MOVLW 0X06
    MOVWF ADCON1
    BANKSEL TRISA
    BSF TRISA,0
    CLRF TRISB
    CLRF TRISD
    BANKSEL PORTD
    CLRF PORTD
    CLRF PORTB
    CLRF PORTA
    MOVLW D'72'
    MOVWF SAYI
    MOVLW D'10'
    MOVWF ON
    MOVLW D'0'
    MOVWF ONLAR
BUTON
    BTFSS PORTA,0
    GOTO BIRLERIS
    GOTO BUTON
BIRLERIS
    MOVFW ON
    SUBWF SAYI,F
    BTFSS STATUS,C
    GOTO BIRLERBUL
    INCF ONLAR
    GOTO BIRLERIS
BIRLERBUL
    MOVFW ON
    ADDWF SAYI
    MOVFW SAYI
    MOVWF PORTD    
    MOVFW ONLAR
    MOVWF PORTB  

    END

