    LIST P=16F877A
    #INCLUDE <P16F877A.INC>
    __CONFIG H'3F31'
    SAYAC EQU 0X23
    SAY EQU 0X24 
    SAY10 EQU 0X27
    BEKLE EQU 0X25
    BEKLE2 EQU 0X26
    ORG 0X00
    GOTO MAIN
    ORG 0X04
    GOTO KESME
MAIN
    BANKSEL TRISB
    CLRF TRISB
    CLRF TRISD
    BANKSEL PORTB
    CLRF PORTB
    CLRF PORTD
    MOVLW 0X05
    MOVWF SAYAC
    MOVLW 0X00
    MOVWF SAY
    MOVWF SAY10
    BANKSEL TMR1L
    MOVLW 0XB0
    MOVWF TMR1L
    MOVLW 0X3C
    MOVWF TMR1H
    BANKSEL INTCON
    BSF INTCON,GIE
    BSF INTCON, PEIE
    BANKSEL PIE1
    BSF PIE1,TMR1IE
    BANKSEL T1CON
    BCF T1CON,T1CKPS0
    BSF T1CON,T1CKPS1
    BSF T1CON,TMR1ON
DONGU
    GOTO DONGU
KESME
    BANKSEL PIR1
    BCF PIR1,TMR1IF
    BANKSEL TMR1L
    MOVLW 0XB0
    MOVWF TMR1L
    MOVLW 0X3C
    MOVWF TMR1H
    DECFSZ SAYAC,F
    RETFIE
    CALL ISLEM    
    BANKSEL SAYAC
    MOVLW 0X05
    MOVWF SAYAC    
    RETFIE
ISLEM
    MOVFW SAY
    SUBLW 0X0A
    BTFSS STATUS,Z
    GOTO GOSTER
    CLRF SAY
    RETURN
GOSTER
    MOVFW SAY
    CALL LOOKUP
    MOVWF PORTD
    BSF PORTB,4
    BSF PORTB,6
    CALL BEKLEME
    BCF PORTB,6
    INCF SAY    
    
    RETFIE
LOOKUP
    ADDWF PCL,F
    RETLW B'00111111'   
    RETLW B'00000110'    
    RETLW B'01011011'    
    RETLW B'01001111'    
    RETLW B'01100110'    
    RETLW B'01101101'    
    RETLW B'01111101'    
    RETLW B'00000111'    
    RETLW B'01111111'    
    RETLW B'01101111'
    RETURN
BEKLEME
    MOVLW 0X55
    MOVWF BEKLE
BEKLEME2
    MOVLW 0X15
    MOVWF BEKLE2
BEKLED
    DECFSZ BEKLE2,F
    GOTO BEKLED
    DECFSZ BEKLE,F
    GOTO BEKLEME2
    RETURN
    END
    

