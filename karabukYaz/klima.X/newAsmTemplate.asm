    LIST P=16F877A
    INCLUDE <P16F877A.INC>
    __CONFIG _CP_OFF &_WDT_OFF &_HS_OSC &_PWRTE_OFF &_LVP_OFF
;  KOD KORUMA, UYKU MODU, HS OSC SEÇ?M?, -- , LOW PROGRAMMING KAPALI
 SAYAC0 EQU 0X20
 SAYAC1 EQU 0X21
 SAYAC2 EQU 0X22
 KAYDIR EQU 0X23
 BIRLER EQU 0X24
 ONLAR	EQU 0X25
 YUZLER EQU 0X26
 BINLER EQU 0X27
 BIRKNT	EQU 0X28
 ONKNT	EQU 0X29
 YUZKNT	EQU 0X2A
 BINKNT EQU 0X2B
 ISTENEN EQU 0X2C
 ISI	EQU 0X2D
 TEMP	EQU 0X2E
 TEMP1	EQU 0X2E
; ----------------------- BA?LANGIÇ AYARLARI //KESME ALTPROGRAMI
    ORG 0X00
    GOTO MAIN	    
    
    ORG 0X04
    GOTO MAIN	    
; ----------------------- STATUS,RP0 (BANKSEL ARASI GEÇ??)
BANK0 MACRO
    BCF STATUS,5    
    ENDM
BANK1 MACRO
    BSF STATUS,5
    ENDM
;---------------------- BA?LANGIÇ ALTPROGRAM VE SONSUZ DONGU    
MAIN BANK1
    MOVLW B'11110000'
    MOVWF TRISD
    CLRF TRISB
    CLRF TRISC
    BANK0
    CLRF PORTC
    CLRF PORTD
    CLRF PORTB 
    MOVLW 0X00
    MOVWF BINLER    ;RB0
    MOVLW 0X00
    MOVWF YUZLER    ;RB1
    MOVLW 0X00
    MOVWF ONLAR	    ;RB2
    MOVLW 0X00
    MOVWF BIRLER    ;RB3
    MOVLW .20
    MOVWF ISTENEN
    MOVLW .23
    MOVWF ISI ;SENSORDEN GELEN
    CLRW

LOOP
    CALL ISITSOGUT
    CALL KEYPAD ;4*1.5MS 6MS 
    CALL BASAMAKBUL
    CALL GOSTER ;6MS    
    GOTO LOOP

BASAMAKBUL
    CLRF ONLAR
    CLRF BIRLER
    MOVF ISTENEN,W
    MOVWF TEMP
BASAMAKBUL1
    BCF STATUS,C
    BCF STATUS,Z
    MOVLW 0X0A
    SUBWF TEMP,W ;W=ISTENEN-ISI
    BTFSC STATUS,Z
    GOTO ESITLIK1
    BTFSC STATUS,C
    GOTO BUYUKLUK1
    MOVFW TEMP
    MOVWF BIRLER
    RETURN
ESITLIK1
    INCF ONLAR,F
    RETURN
BUYUKLUK1
    INCF ONLAR,F
    MOVLW 0X0A
    SUBWF TEMP,F ;W=ISTENEN-ISI
    GOTO BASAMAKBUL1
ISITSOGUT
    BCF STATUS,C
    BCF STATUS,Z
    MOVFW ISI
    SUBWF ISTENEN,W ;W=ISTENEN-ISI
    BTFSC STATUS,Z
    GOTO ESITLIK
    BTFSC STATUS,C
    GOTO BUYUKLUK
    GOTO KUCUKLUK
    RETURN
ESITLIK
    BCF PORTC,0
    BCF PORTC,1
    RETURN
BUYUKLUK
    BSF PORTC,1 ;ISITICI
    BCF PORTC,0 ;SOGUTUCU
    RETURN
KUCUKLUK
    BCF PORTC,1 ;ISITICI
    BSF PORTC,0 ;SOGUTUCU
    RETURN
    
    
KEYPAD
;----------- 1. SATIR TARAMA BA?LADI -----------
    MOVLW B'11110111'
    MOVWF PORTD ; 1. SATIR SEC?LD? 1234
    CALL BEKLE
B1
    BTFSC PORTD,4
    GOTO B2
    MOVLW 0X00
    MOVWF ONLAR
    MOVLW 0X01
    MOVWF BIRLER
    RETURN
B2
    BTFSC PORTD,5
    GOTO B3
    ;YUKARI BUTON
    INCF ISTENEN,F
    BCF STATUS,Z
    MOVLW .33
    SUBWF ISTENEN,W
    BTFSC STATUS,Z
    DECF ISTENEN,F
    RETURN
B3
    BTFSC PORTD,6
    GOTO B4
    MOVLW 0X00
    MOVWF ONLAR
    MOVLW 0X03
    MOVWF BIRLER
    RETURN
B4
    BTFSC PORTD,7
    GOTO B5
    MOVLW 0X00
    MOVWF ONLAR
    MOVLW 0X04
    MOVWF BIRLER
    RETURN
;----------- 1. SATIR SON --------------
;----------- 2. SATIR TARAMA BA?LADI -----------
B5
    MOVLW B'11111011'
    MOVWF PORTD ; 2. SATIR SEC?LD? 1234
    CALL BEKLE
    BTFSC PORTD,4
    GOTO B6
    MOVLW 0X00
    MOVWF ONLAR
    MOVLW 0X05
    MOVWF BIRLER
    RETURN
B6
    BTFSC PORTD,5
    GOTO B7
    ;ASAGI BUTON
    DECF ISTENEN,F
    BCF STATUS,Z
    MOVLW .15
    SUBWF ISTENEN,W
    BTFSC STATUS,Z
    INCF ISTENEN,F    
    RETURN
B7
    BTFSC PORTD,6
    GOTO B8
    MOVLW 0X00
    MOVWF ONLAR
    MOVLW 0X07
    MOVWF BIRLER
    RETURN
B8
    BTFSC PORTD,7
    GOTO B9
    MOVLW 0X00
    MOVWF ONLAR
    MOVLW 0X08
    MOVWF BIRLER
    RETURN
;----------- 2. SATIR SON --------------
;----------- 3. SATIR TARAMA BA?LADI -----------
B9
    MOVLW B'11111101'
    MOVWF PORTD ; 3. SATIR SEC?LD? 1234
    CALL BEKLE
    BTFSC PORTD,4
    GOTO B10
    MOVLW 0X00
    MOVWF ONLAR
    MOVLW 0X09
    MOVWF BIRLER
    RETURN
B10
    BTFSC PORTD,5
    GOTO B11
    MOVLW 0X01
    MOVWF ONLAR
    MOVLW 0X00
    MOVWF BIRLER
    RETURN
B11
    BTFSC PORTD,6
    GOTO B12
    MOVLW 0X01
    MOVWF ONLAR
    MOVLW 0X01
    MOVWF BIRLER
    RETURN
B12
    BTFSC PORTD,7
    GOTO B13
    MOVLW 0X01
    MOVWF ONLAR
    MOVLW 0X02
    MOVWF BIRLER
    RETURN
;----------- 3. SATIR SON -------------- 
;----------- 4. SATIR TARAMA BA?LADI -----------
B13
    MOVLW B'11111110'
    MOVWF PORTD ; 4. SATIR SEC?LD? 1234
    CALL BEKLE
    BTFSC PORTD,4
    GOTO B14
    MOVLW 0X01
    MOVWF ONLAR
    MOVLW 0X03
    MOVWF BIRLER
    RETURN
B14
    BTFSC PORTD,5
    GOTO B15
    MOVLW 0X01
    MOVWF ONLAR
    MOVLW 0X04
    MOVWF BIRLER
    RETURN
B15
    BTFSC PORTD,6
    GOTO B16
    MOVLW 0X01
    MOVWF ONLAR
    MOVLW 0X05
    MOVWF BIRLER
    RETURN
B16
    BTFSC PORTD,7
    RETURN
    MOVLW 0X01
    MOVWF ONLAR
    MOVLW 0X06
    MOVWF BIRLER
    RETURN
;----------- 4. SATIR SON --------------
    GOTO KEYPAD
    
    
    
GOSTER
    MOVLW .15
    MOVWF TEMP1
GOSTER1
    MOVFW BINLER	    ;BINLER BASILDI
    MOVWF PORTD
    MOVLW B'00000001'	    ;RB0 AKT?F
    MOVWF PORTB
    CALL BEKLE
    
    MOVFW YUZLER	    ;YUZLER BASILDI
    MOVWF PORTD
    MOVLW B'00000010'	    ;RB1 AKT?F
    MOVWF PORTB
    CALL BEKLE
    
    MOVFW ONLAR		    ;ONLAR BASILDI
    MOVWF PORTD
    MOVLW B'00000100'	    ;RB2 AKT?F
    MOVWF PORTB
    CALL BEKLE
    
    MOVFW BIRLER	    ;BIRLER BASILDI
    MOVWF PORTD
    MOVLW B'00001000'	    ;RB3 AKT?F
    MOVWF PORTB
    CALL BEKLE
    DECFSZ TEMP1,F
    GOTO GOSTER1
    CLRF PORTB
    RETURN
    
    
BEKLE
    MOVLW .2      ; 2 3MS
    MOVWF SAYAC0
BEKLE1
    MOVLW .50
    MOVWF SAYAC1
BEKLE2
    MOVLW .50
    MOVWF SAYAC2
BEKLEDONGU
    DECFSZ SAYAC2,F
    GOTO BEKLEDONGU
    DECFSZ SAYAC1,F
    GOTO BEKLE2
    DECFSZ SAYAC0,F
    GOTO BEKLE1
    RETURN
    END
















