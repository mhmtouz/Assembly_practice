    LIST P=16F877A
    INCLUDE <P16F877A.INC>
    __CONFIG _CP_OFF &_WDT_OFF &_HS_OSC &_PWRTE_OFF &_LVP_OFF
;--- KOD KORUMA, UYKU MODU, HS OSC SEÇ?M?, -- , LOW PROGRAMMING OFF
SAYAC0	EQU 0X20
SAYAC1	EQU 0X21
SAYAC2	EQU 0X22
HIZ	EQU 0X23
YONKNT	EQU 0X24
;----------------------- BA?LANGIÇ AYARLARI //KESME ALTPROGRAMI
    ORG 0X00
    GOTO MAIN	    
    
    ORG 0X04
    GOTO MAIN	    
; ----------------------- STATUS,RP0 (BANKSEL ARASI GEÇ??)
BANK0 MACRO
    BCF STATUS,5    
    ENDM
BANK1 MACRO
    BSF STATUS,5
    ENDM
;---------------------- BA?LANGIÇ ALTPROGRAM VE SONSUZ DONGU    
MAIN BANK1
    MOVLW .255
    MOVWF PR2    ; fPWM=4.88KHZ
    MOVLW 0X06
    MOVWF ADCON1
    MOVLW B'11110000' ; ANALOG D??TAL AYARLA
    MOVWF TRISD
    CLRF TRISC
    CLRF TRISA 
    BANK0
    MOVLW B'00001100'
    MOVWF CCP1CON ; PWM MODU AKTIF 10BIT LSB DEN 2 BIT 00 ALDIK (SOLA DAYALI) TDUTY ?Ç?N
    MOVLW B'00000101'
    MOVWF T2CON ; TMR2ON VE T2PRE=4 4.88KHZ (PRE=1 ?LE 4X4.88KHZ)
    CLRF CCPR1L ; TDUTY=0 RC2=0V
    CLRF PORTC ;DC YON KONTROLU VE CCP1-RC2 PWM S?NYAL?
    CLRF PORTD
    CLRF PORTA 
    MOVLW .50
    MOVWF HIZ
    CLRW
;----------------------------------------------------
LOOP
    CALL BUTONTARA
    GOTO LOOP
;---------------------------------------------------------------    
BUTONTARA
    BTFSC PORTD,0
    BSF YONKNT,0
    BTFSC PORTD,1
    BCF YONKNT,0
    BTFSC PORTD,2
    GOTO HIZLAN
    BTFSC PORTD,3
    GOTO YAVASLA
    BTFSC YONKNT,0
    GOTO SAGA
    GOTO SOLA
    RETURN
;-----------------------------------------
SAGA BANK0
    MOVLW B'00001010'
    MOVWF PORTA
    MOVWF PORTC
    CALL BEKLE
    MOVLW B'00000110'
    MOVWF PORTA
    MOVWF PORTC
    CALL BEKLE
    MOVLW B'00000101'
    MOVWF PORTA
    MOVWF PORTC
    CALL BEKLE
    MOVLW B'00001001'
    MOVWF PORTA
    MOVWF PORTC
    CALL BEKLE
    CLRF PORTA
    GOTO LOOP
SOLA BANK0
    MOVLW B'00001001'
    MOVWF PORTA
    MOVWF PORTC
    CALL BEKLE 
    MOVLW B'00000101'
    MOVWF PORTA
    MOVWF PORTC
    CALL BEKLE
    MOVLW B'00000110'
    MOVWF PORTA
    MOVWF PORTC
    CALL BEKLE
    MOVLW B'00001010'
    MOVWF PORTA
    MOVWF PORTC
    CALL BEKLE
    CLRF PORTA
    GOTO LOOP
 ;-------------------------------------------------
HIZLAN
    MOVLW .30
    MOVWF HIZ
    GOTO LOOP
YAVASLA
    MOVLW .120
    MOVWF HIZ
    GOTO LOOP
;-----------------------------------------------------
BEKLE
    MOVFW HIZ     
    MOVWF SAYAC0
BEKLE1
    MOVLW .50
    MOVWF SAYAC1
BEKLE2
    MOVLW .50
    MOVWF SAYAC2
BEKLEDONGU
    DECFSZ SAYAC2,F
    GOTO BEKLEDONGU
    DECFSZ SAYAC1,F
    GOTO BEKLE2
    DECFSZ SAYAC0,F
    GOTO BEKLE1
    RETURN
    END



